## firmware/caltreat_chipper_reader/src/Kconfig.projbuild
```kconfig
menu "Chipper reader network"

    config CHIPPER_BACKEND_URL
        string "Backend base URL (no trailing slash)"
        default "https://ctr-api-487080838958.us-west1.run.app"

    config CHIPPER_BACKEND_PROBE_S
        int "Seconds between backend health checks while reachable"
        default 30
        range 5 3600

    config CHIPPER_NET_REINIT_S
        int "Reinstall the Ethernet driver after this many seconds without an address"
        default 300
        range 30 86400

    config CHIPPER_SAME_READER_IGNORE_MIN
        int "Ignore a tap off at the reader the card tapped on at, for this many minutes"
        default 30
        range 0 1440
        help
            A second tap at the gate a rider just tapped on at is shown as
            "already tapped on" instead of closing the trip. After this
            window it counts as a normal tap off.

endmenu
```

## firmware/caltreat_vms_controller/src/Kconfig.projbuild
```kconfig
menu "CalTreat VMS network"

    config VMS_BACKEND_URL
        string "Backend base URL (no trailing slash)"
        default "https://ctr-web-487080838958.us-west1.run.app"

    config VMS_BACKEND_PROBE_S
        int "Seconds between backend health checks while reachable"
        default 30
        range 5 3600

    config VMS_POLL_S
        int "Seconds between polls of the timetable"
        default 10
        range 2 600

    config VMS_STALE_S
        int "Show 'real-time information unavailable' after this many seconds without a good poll"
        default 120
        range 10 3600

    config VMS_NET_REINIT_S
        int "Reinstall the Ethernet driver after this many seconds without an address"
        default 300
        range 30 86400

endmenu
```

## firmware/shared_esp_components/net_ota/Kconfig
```kconfig
menu "Network OTA (net_ota)"

    config NET_OTA_PORT
        int "HTTP port of the update server"
        default 80
        range 1 65535

    config NET_OTA_MAX_SOCKETS
        int "Max open sockets of the server net_ota starts itself"
        default 2
        range 1 7
        help
            httpd reserves 3 more sockets internally. The default of 2 leaves most of
            LWIP_MAX_SOCKETS for the application's own client connections.

    config NET_OTA_BUF_SIZE
        int "Receive buffer size (bytes)"
        default 4096
        range 1024 65536

    config NET_OTA_CONFIRM_TIMEOUT_S
        int "Seconds a new image has to call net_ota_mark_valid()"
        default 120
        range 10 3600
        help
            After an update the new image boots as PENDING_VERIFY. If it has not called
            net_ota_mark_valid() within this time, net_ota restarts the chip and the
            bootloader rolls back to the previous image. Needs
            BOOTLOADER_APP_ROLLBACK_ENABLE.

endmenu
```

## firmware/shared_esp_components/usb_eth/Kconfig
```kconfig
menu "USB Ethernet (usb_eth)"

    # esp_eth only builds its core (esp_eth.c, 802.3 PHY base, netif glue) when
    # an Ethernet controller selects ETH_ENABLED; the ESP32-S3 has no EMAC.
    # In IDF 5.4 esp_eth_driver.h also only gets esp_eth_mac.h through the
    # EMAC / SPI / OpenETH headers, so with none of them enabled esp_eth itself
    # fails to compile. Enabling the SPI Ethernet umbrella option (no chip
    # drivers selected, so no extra code) works around that.
    config USB_ETH_ESP_ETH
        bool
        default y
        select ETH_ENABLED
        select ETH_USE_SPI_ETHERNET if !ETH_USE_ESP32_EMAC && !ETH_USE_OPENETH

    config USB_ETH_ATTACH_TIMEOUT_MS
        int "Wait for an adapter during esp_eth_driver_install (ms)"
        default 3000
        range 0 600000
        help
            esp_eth_driver_install() waits up to this long for the first supported adapter so
            that its own MAC address can be used. If none shows up, the driver continues with
            the ESP's Ethernet MAC address and binds to an adapter when it is plugged in later.

    config USB_ETH_RX_XFER_SIZE
        int "Bulk-IN transfer size (bytes, 0 = driver default)"
        default 0
        range 0 65536
        help
            0 lets the driver pick the size for the chip and the USB speed (see the driver's
            options below). Otherwise this size is requested for every adapter; the driver
            rounds it to what the endpoint (64-byte packets at full speed on the ESP32-S3,
            512 at high speed on the ESP32-P4) and its wire format need.

    config USB_ETH_RX_XFER_COUNT
        int "Bulk-IN transfers in flight"
        default 4 if IDF_TARGET_ESP32P4
        default 3
        range 1 16

    config USB_ETH_TX_XFER_COUNT
        int "Bulk-OUT transfers (TX queue depth)"
        default 8 if IDF_TARGET_ESP32P4
        default 4
        range 1 16

    config USB_ETH_TX_TIMEOUT_MS
        int "Wait for a free TX transfer (ms)"
        default 50
        range 0 10000

    config USB_ETH_CTRL_TIMEOUT_MS
        int "Register access (control transfer) timeout (ms)"
        default 1000
        range 10 10000

    config USB_ETH_ACCEPT_ALL_MULTICAST
        bool "Accept all multicast frames"
        default y
        help
            ESP-IDF 5.4's esp_eth has no multicast filter API, so by default every multicast
            frame is accepted (IPv6 neighbour discovery, mDNS and IGMP groups then work without
            extra code). Disable to only accept groups added with USB_ETH_CMD_ADD_MCAST; on
            ESP-IDF >= 5.5 the groups lwIP joins (IGMP/MLD) are also added automatically
            (ETH_CMD_ADD_MAC_FILTER), up to 16 in total.

    config USB_ETH_WORKER_TASK_STACK_SIZE
        int "Attach/detach worker task stack size"
        default 4096
        range 2048 16384

    config USB_ETH_WORKER_TASK_PRIO
        int "Attach/detach worker task priority"
        default 5
        range 1 24

    menu "Drivers"
        rsource "drivers/rtl815x/Kconfig"
    endmenu

endmenu
```

## firmware/shared_esp_components/usb_eth/drivers/rtl815x/Kconfig
```kconfig
config USB_ETH_DRV_RTL815X
    bool "Realtek RTL815x (RTL8152, RTL8153B)"
    default y
    help
        Vendor driver for Realtek RTL8152 (0bda:8152) and RTL8153B (0bda:8153) adapters,
        derived from FreeBSD ure(4). The chip is identified by its version register, so
        RTL8153A and RTL8156 chips with these IDs are rejected.

if USB_ETH_DRV_RTL815X

    config USB_ETH_RTL815X_RX_SIZE_8152_HS
        int "RTL8152 bulk-IN transfer size at high speed (bytes)"
        default 16384
        range 2048 65536
        help
            Used when USB_ETH_RX_XFER_SIZE is 0 and the adapter runs at high speed
            (ESP32-P4). The chip aggregates several frames per transfer; frames that do
            not fit continue in the next transfer.

    config USB_ETH_RTL815X_RX_SIZE_8153B_HS
        int "RTL8153B bulk-IN transfer size at high speed (bytes)"
        default 16384
        range 4096 65536
        help
            Used when USB_ETH_RX_XFER_SIZE is 0 and the adapter runs at high speed. The
            chip's RX aggregation threshold (USB_RX_EARLY_SIZE) is derived from it. On a
            100 Mbit/s link 16 KiB and 32 KiB (FreeBSD's RTL8153 buffer size) gave the
            same TCP receive rate on the ESP32-P4; 32 KiB costs 64 KiB more internal RAM
            with 4 transfers in flight and may help at gigabit rates (not measured).

    config USB_ETH_RTL815X_RX_SIZE_FS
        int "Bulk-IN transfer size at full speed (bytes)"
        default 4096
        range 1600 16384
        help
            Used when USB_ETH_RX_XFER_SIZE is 0 and the adapter runs at full speed
            (ESP32-S3), for every chip.

endif
```
